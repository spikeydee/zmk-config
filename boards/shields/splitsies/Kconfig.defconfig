## boards/shields/splitsies/Kconfig.defconfig
```kconfig
if SHIELD_SPLITSIES_DONGLE

config ZMK_KEYBOARD_NAME
    default "splitsies"
    
config ZMK_SPLIT_ROLE_CENTRAL
    default y
    
config ZMK_USB
    default y

endif

if SHIELD_SPLITSIES_DONGLE || SHIELD_SPLITSIES_LEFT || SHIELD_SPLITSIES_RIGHT

config ZMK_SPLIT
    default y
    
config ZMK_BLE
    default y
   
endif
```

## boards/shields/splitsies/Kconfig.shield
```kconfig
config SHIELD_SPLITSIES_CENTRAL
    def_bool $(shields_list_contains,splitsies_central)

config SHIELD_SPLITSIES_LEFT
    def_bool $(shields_list_contains,splitsies_left)

config SHIELD_SPLITSIES_RIGHT
    def_bool $(shields_list_contains,splitsies_right)
```

## config/Kconfig.shield
```kconfig
config SHIELD_SPLITSIES_DONGLE
    def_bool $(shields_list_contains,splitsies_dongle)

config SHIELD_SPLITSIES_LEFT
    def_bool $(shields_list_contains,splitsies_left)

config SHIELD_SPLITSIES_RIGHT
    def_bool $(shields_list_contains,splitsies_right)
```
